// SPDX-License-Identifier: (GPL-2.0+ OR MIT)
/*
 * Copyright 2020 Technexion Ltd.
 *
 * Author: Richard Hu <richard.hu@technexion.com>
 *
 */

/dts-v1/;

//#include <dt-bindings/phy/phy-imx8-pcie.h>
#include "imx8mm-edm-g.dtsi"

//#define CODEC_SGTL5000

/ {
	model = "FACSCOPE-IMX8MM";
	compatible = "fsl,imx8mm-facscope", "fsl,imx8mm";

	regulators {
		compatible = "simple-bus";
		#address-cells = <1>;
		#size-cells = <0>;

		reg_usb_otg_vbus: usb_otg_vbus {
			pinctrl-names = "default";
			pinctrl-0 = <&pinctrl_otg_vbus>;
			compatible = "regulator-fixed";
			regulator-name = "usb_otg_vbus";
			regulator-min-microvolt = <3300000>;
			regulator-max-microvolt = <3300000>;
			gpio = <&gpio1 10 GPIO_ACTIVE_LOW>;
			enable-active-low;
		};

		reg_lvds_pwr: regulator_lvdspwr {
			pinctrl-names = "default";
			pinctrl-0 = <&pinctrl_lvds0_pwr>;
			compatible = "regulator-fixed";
			regulator-name = "lvds0_vdden";
			regulator-min-microvolt = <3300000>;
			regulator-max-microvolt = <3300000>;
			gpio = <&gpio1 7 GPIO_ACTIVE_HIGH>;
			enable-active-high;
			status = "okay";
		};

		reg_lvds_backlight_pwr: regulator_lvdsblpwr {
			pinctrl-names = "default";
			pinctrl-0 = <&pinctrl_lvds0_backlight_pwr>;
			compatible = "regulator-fixed";
			regulator-name = "lvds0_bl_en";
			regulator-min-microvolt = <3300000>;
			regulator-max-microvolt = <3300000>;
			gpio = <&gpio1 12 GPIO_ACTIVE_HIGH>;
			enable-active-high;
			regulator-always-on;
		};

		reg_2p7v: regulator-2p7v {
			compatible = "regulator-fixed";
			regulator-name = "2p7v";
			regulator-min-microvolt = <2700000>;
			regulator-max-microvolt = <2700000>;
			regulator-always-on;
		};

		reg_1p2v: regulator-1p2v {
			compatible = "regulator-fixed";
			regulator-name = "1p2v";
			regulator-min-microvolt = <1200000>;
			regulator-max-microvolt = <1200000>;
			regulator-always-on;
		};

		reg_1p8v: regulator-1p8v {
			compatible = "regulator-fixed";
			regulator-name = "1p8v";
			regulator-min-microvolt = <1800000>;
			regulator-max-microvolt = <1800000>;
			regulator-always-on;
		};

	};

	lvds_backlight: lvds_backlight {
		compatible = "pwm-backlight";
		pwms = <&pwm2 0 50000 0>;
		brightness-levels = <0 36 72 108 144 180 216 255>;
		default-brightness-level = <6>;
		status = "okay";
	};

	usb_hub_rst: usb_hub_rst {
		compatible = "gpio-reset";
		pinctrl-names = "default";
		pinctrl-0 = <&pinctrl_usb_hub_ctrl>;
		reset-gpios = <&gpio3 0 GPIO_ACTIVE_LOW>;
		reset-delay-us = <10>;
		#reset-cells = <0>;
	};

#ifdef CODEC_SGTL5000
	sound_sgtl5000 {
			compatible = "fsl,sgtl5000", "fsl,imx-audio-sgtl5000";
			model = "sgtl5000";
			codec-master;
			ssi-controller = <&sai2>;
			audio-codec = <&codec_sgtl5000>;
			audio-routing =
					"MIC_IN", "Mic Jack",
					"Mic Jack", "Mic Bias",
					"Headphone Jack", "HP_OUT";
			no-audmux;
	};
#else
	sound_wm8960: sound-wm8960 {
		compatible = "fsl,imx-audio-wm8960";
		model = "wm8960-audio";
		audio-cpu = <&sai2>;
		codec-master;
		audio-codec = <&codec_wm8960>;
		/* JD2: hp detect high for headphone*/
		hp-det = <2 0>;
		audio-routing =
			"Headphone Jack", "HP_L",
			"Headphone Jack", "HP_R",
			"Ext Spk", "SPK_LP",
			"Ext Spk", "SPK_LN",
			"Ext Spk", "SPK_RP",
			"Ext Spk", "SPK_RN",
			"LINPUT1", "Mic Jack",
			"RINPUT1", "Mic Jack",
			"Mic Jack", "MICB",
			"AMIC", "MICB";
	};
#endif

	clocks {
		assigned-clocks = <&clk IMX8MM_CLK_CLKO2>;
		assigned-clock-parents = <&clk IMX8MM_CLK_24M>;
		assigned-clock-rates = <24000000>;

		codec_osc: aud_mclk {
			compatible = "fixed-clock";
			#clock-cells = <0>;
			clock-frequency = <24000000>;
			clock-output-names = "wm8960-mclk";
		};
	};
};


&gpio1 {
	status = "okay";
	pinctrl-0 = <&pinctrl_gpio1>;
	gpio-line-names = \
		"WL_REG_ON", "pwm1", "bt_ctrl", "BT_REG_ON", "", "P136", "P138", "lvdspwr", \
		"P241", "P243", "otgvbus", "P71", "lvdsblpwr", "Touch INT", "P140", "SPI3_CS1", \
		"", "", "", "", "", "", "", "", \
		"", "", "", "", "", "", "", "";

	lvds-pwr-on {
		pinctrl-names = "default";
		pinctrl-0 = <&pinctrl_lvds0_pwr>;
		gpio-hog;
		gpios = <7 GPIO_ACTIVE_HIGH>;
		output-high;
	};

	lvds-bl-pwr-on {
		pinctrl-names = "default";
		pinctrl-0 = <&pinctrl_lvds0_backlight_pwr>;
		gpio-hog;
		gpios = <12 GPIO_ACTIVE_HIGH>;
		output-high;
	};	
};

&gpio2 {
	status = "okay";
	pinctrl-0 = <&pinctrl_gpio2>;
	gpio-line-names = \
		"", "", "", "", "", "", "", "ENET_nRST", \
		"P249", "P251", "", "P255", "usdhc2_cd", "", "", "", \
		"", "", "", "usdhc2_rst", "", "", "", "", \
		"", "", "", "", "", "", "", "";
};

&gpio3 {
	status = "okay";
	pinctrl-0 = <&pinctrl_gpio3>;
	gpio-line-names = \
		"USB_HUB_RST", "SPI2_CS1", "", "", "", "", "", "pmicirq", \
		"", "sn65dsi84_en", "", "", "", "", "", "", \
		"", "", "", "", "", "", "", "", \
		"", "TOUCH_nRST", "", "", "", "", "", "";
};

&gpio4 {
	status = "okay";
	pinctrl-0 = <&pinctrl_gpio4>;
	gpio-line-names = \
		"fecpwr_en", "SPI2_CS2", "", "", "", "", "", "", \
		"", "", "", "", "", "", "", "", \
		"", "", "", "", "SPI2_CS3", "", "", "", \
		"", "", "", "", "", "SPI3_CS2", "SPI3_CS3", "";
};

&gpio5 {
	status = "okay";
	pinctrl-0 = <&pinctrl_gpio5>;
	gpio-line-names = \
		"", "P245", "", "bl_pwm2", "", "", "", "", \
		"", "", "", "", "", "SPI2_CS0", "", "", \
		"", "", "", "", "", "", "", "", \
		"", "SPI3_CS0", "", "", "", "", "", "";

	bl-pwm-on { 
		pinctrl-names = "default";
		pinctrl-0 = <&pinctrl_lvds0_backlight_pwm>;
		gpio-hog;
		gpios = <4 GPIO_ACTIVE_HIGH>;
		output-high;
	};
};


&iomuxc {
	pinctrl_csi_reset: csi_reset {
		fsl,pins = <
			MX8MM_IOMUXC_GPIO1_IO05_GPIO1_IO5		0x16 //P136
			>;
	};

	pinctrl_csi_pwdn: csi_pwdn {
		fsl,pins = <
			MX8MM_IOMUXC_GPIO1_IO06_GPIO1_IO6		0x16 //P138		
			>;
	};

	pinctrl_gpio1: gpio1grp {
		fsl,pins = <
			MX8MM_IOMUXC_GPIO1_IO08_GPIO1_IO8		0x16 //P241
			MX8MM_IOMUXC_GPIO1_IO09_GPIO1_IO9 		0x16 //P243
			MX8MM_IOMUXC_GPIO1_IO11_GPIO1_IO11		0x16 //P71
			MX8MM_IOMUXC_GPIO1_IO14_GPIO1_IO14		0x16 //P140
		>;
	};

	pinctrl_gpio2: gpio2grp {
		fsl,pins = <
			MX8MM_IOMUXC_SD1_DATA6_GPIO2_IO8		0x16 //P249
			MX8MM_IOMUXC_SD1_DATA7_GPIO2_IO9		0x16 //P251
			MX8MM_IOMUXC_SD1_STROBE_GPIO2_IO11		0x16 //P255
		>;
	};

	pinctrl_gpio3: gpio3grp {
		fsl,pins = <
			MX8MM_IOMUXC_SAI5_RXC_GPIO3_IO20		0x16 //WL_HOST_WAKE
			MX8MM_IOMUXC_NAND_ALE_GPIO3_IO0  0x16 // USB_HUB_RST
		>;
	};	

	pinctrl_gpio4: gpio4grp {
		fsl,pins = <
			MX8MM_IOMUXC_SAI1_MCLK_GPIO4_IO20		0x16 //PCIE_RST_N
		>;
	};	

	pinctrl_gpio5: gpio5grp {
		fsl,pins = <
			MX8MM_IOMUXC_SAI3_TXD_GPIO5_IO1 		0x16 //P245
		>;
	};

	pinctrl_otg_vbus: otgvbusgrp {
		fsl,pins = <
			MX8MM_IOMUXC_GPIO1_IO10_GPIO1_IO10		0x19 /* USB OTG VBUS Enable */
		>;
	};

	pinctrl_usb_hub_ctrl: usbhubctrlgrp {
		fsl,pins = <
			MX8MM_IOMUXC_NAND_ALE_GPIO3_IO0		0x39 /* open-drain, USB_HUB_RESET */
		>;
	};

	pinctrl_hd3ss3220_irq: hd3ss3220_irqgrp {
		fsl,pins = <
			MX8MM_IOMUXC_SD1_RESET_B_GPIO2_IO10		0x41	/* GPIO_P253 */
		>;
	};

	pinctrl_lvds0_backlight_pwr: lvds0_bl_pwrgrp {
		fsl,pins = <
			MX8MM_IOMUXC_GPIO1_IO12_GPIO1_IO12		0x19
		>;
	};

	pinctrl_lvds0_pwr: lvds0_pwrgrp {
		fsl,pins = <
			MX8MM_IOMUXC_GPIO1_IO07_GPIO1_IO7		0x19
		>;
	};
	pinctrl_pca9555_a21_irq: pca9555_a21_irqgrp {
		fsl,pins = <
			MX8MM_IOMUXC_GPIO1_IO15_GPIO1_IO15		0x150
		>;
	};

	pinctrl_pca9555_a23_irq: pca9555_a23_irqgrp {
		fsl,pins = <
			MX8MM_IOMUXC_SAI3_RXFS_GPIO4_IO28		0x150	/* GPIO_P247 */
		>;
	};

	pinctrl_touch_irq: touch_irqgrp {
		fsl,pins = <
			MX8MM_IOMUXC_GPIO1_IO13_GPIO1_IO13		0x41 /* Touch INT */
		>;
	};

	pinctrl_touch_reset: touch_rstgrp {
		fsl,pins = <
			MX8MM_IOMUXC_SAI5_MCLK_GPIO3_IO25		0x41 /* TOUCH_nRST, LVDS1_VDDEN */
		>;
	};
};


&mipi_dsi {
	status = "okay";
	#address-cells = <1>;
	#size-cells = <0>;
	panel@0 {
		reg = <0>;
		compatible = "tn,g150xtn035-panel";
		backlight = <&lvds_backlight>;
		power-supply = <&reg_lvds_pwr>;

		dsi,flags = <0x0003>;
		dsi,format = <0>;
		dsi,lanes = <4>;
		panel-width-mm  = <304>;
		panel-height-mm = <228>;
		bus-format = <0x100a>;	/* MEDIA_BUS_FMT_RGB888_1X24 */
		bus-flags = <1>;
		refresh-rate = <60>;
		rotate = <180>;
		/* horz-flip; */
		/* vert-flip; */

		panel-timing {
			clock-frequency = <66000000>;
			hactive = <1024>;
			vactive = <768>;
			hfront-porch = <90>;
			hsync-len = <140>;
			hback-porch = <90>;
			vfront-porch = <17>;
			vsync-len = <4>;
			vback-porch = <17>;
			/* flags = DISPLAY_FLAGS_HSYNC_HIGH | DISPLAY_FLAGS_VSYNC_HIGH */
			vsync-active = <1>;
			hsync-active = <1>;
		};
	};
};

&lcdif {
	status = "okay";
};

&i2c1 { /* BRD_CONF I2C */
	eeprom_baseboard: eeprom@51 {
		compatible = "atmel,24c02";
		reg = <0x51>;
		pagesize = <16>;
		status = "disabled";
	};

	dsi_lvds_bridge: sn65dsi84@2d {
		sn65dsi84,addresses = <0x09 0x0A 0x0B 0x0D
							0x10 0x11 0x12 0x13
							0x18 0x19 0x1A 0x1B
							0x20 0x21 0x22 0x23
							0x24 0x25 0x26 0x27
							0x28 0x29 0x2A 0x2B
							0x2C 0x2D 0x2E 0x2F
							0x30 0x31 0x32 0x33
							0x34 0x35 0x36 0x37
							0x38 0x39 0x3A 0x3B
							0x3C 0x3D 0x3E 0x0D>;

		sn65dsi84,values = </* 0x09 reset and clock registers */
					0x00 0x05 0x10 0x00
					/* 0x10 DSI registers */
					0x26 0x00 0x2a 0x00
					/* 0x18 LVDS registers */
					0x78 0x00 0x03 0x00

					/* video registers */
					/* 0x20 cha-al-len-l, cha-al-len-h, chb-al-len-l, chb-al-len-h */
					0x00 0x04 0x00 0x00
					/* 0x24 cha-v-ds-l, cha-v-ds-h, chb-v-ds-l, chb-v-ds-h */
					0x00 0x03 0x00 0x00
					/* 0x28 cha-sdl, cha-sdh, chb-sdl, chb-sdh */
					0x21 0x00 0x00 0x00
					/* 0x2C cha-hs-pwl, cha-hs-pwh, chb-hs-pwl, chb-hs-pwh */
					0x8C 0x00 0x00 0x00
					/* 0x30 cha-vs-pwl, cha-vs-pwh, chb-vs-pwl, chb-vs-pwh */
					0x04 0x00 0x00 0x00
					/*0x34 cha-hbp, chb-hbp, cha-vbp, chb-vbp*/
					0x5A 0x00 0x11 0x00
					/* 0x38 cha-hfp, chb-hfp, cha-vfp, chb-vfp*/
					0x5A 0x00 0x11 0x00

					0x00 0x00 0x00 0x01>;
		status = "okay";
	};
};

&i2c2 {
#ifdef CODEC_SGTL5000	
	codec_sgtl5000: sgtl5000@a {
                compatible = "fsl,sgtl5000";
                reg = <0x2a>;
                clocks = <&clk IMX8MM_CLK_SAI2_ROOT>;
                clock-names = "mclk";
                pinctrl-names = "default";
                pinctrl-0 = <&pinctrl_sai2_mclk>;
		assigned-clocks = <&clk IMX8MM_CLK_SAI2>;
		assigned-clock-parents = <&clk IMX8MM_AUDIO_PLL1_OUT>;
		assigned-clock-rates = <24576000>; //12288000 ????
		status = "okay"
	};
#else  
	codec_wm8960: wm8960@1a {
		compatible = "wlf,wm8960";
		reg = <0x1a>;
		#sound-dai-cells = <0>;
		clocks = <&clk IMX8MM_CLK_SAI2>;
		clock-names = "mclk";
		pinctrl-names = "default";
        pinctrl-0 = <&pinctrl_sai2_mclk>;
		wlf,shared-lrclk;
		wlf,hp-cfg = <2 2 3>;
		wlf,fixed-mclk;
		status = "okay";
	};
#endif
	typec_hd3ss3220: hd3ss3220@67 {
		compatible = "ti,hd3ss3220";
		interrupts-extended = <&gpio2 10 IRQ_TYPE_LEVEL_LOW>;
		pinctrl-names = "default";
		pinctrl-0 = <&pinctrl_hd3ss3220_irq>;
		reg = <0x67>;

		ports {
			#address-cells = <1>;
			#size-cells = <0>;

			port@0 {
				reg = <0>;
				hd3ss3220_in_ep: endpoint {
					remote-endpoint = <&otg1_out_ep>;
				};
			};

			port@1 {
				reg = <1>;
				hd3ss3220_out_ep: endpoint {
					remote-endpoint = <&otg1_in_ep>;
				};
			};
		};
	};

	pca9555_a21: pca9555@21 {
		compatible = "nxp,pca9555";
		pinctrl-names = "default";
		// pinctrl-0 = <&pinctrl_pca9555_a21_irq>;
		reg = <0x21>;
		gpio-controller;
		#gpio-cells = <2>;
		// interrupt-controller;
		// #interrupt-cells = <2>;
		// interrupt-parent = <&gpio1>;
		// interrupts = <15 IRQ_TYPE_LEVEL_LOW>;
		status = "okay";
		gpio-line-names = "EXPOSURE_TRIG_IN1", "FLASH_OUT1", "INFO_TRIG_IN1", "CAM_SHUTTER1", "XVS1", "PWR1_TIME0", "PWR1_TIME1", "PWR1_TIME2",
							"EXPOSURE_TRIG_IN2", "FLASH_OUT2", "INFO_TRIG_IN2", "CAM_SHUTTER2", "XVS2", "PWR2_TIME0", "PWR2_TIME1", "PWR2_TIME2";
	};


	ar0521: camera@36 {
		compatible = "onnn,ar0521";
		reg = <0x36>; 

		csi_id = <1>;

		clocks = <&clk IMX8MM_CLK_CLKO2>;
		clock-names = "extclk";

		pinctrl-names = "default";
		pinctrl-0 = <&pinctrl_csi_reset &pinctrl_csi_pwdn>;

		reset-gpios = <&gpio1 5 GPIO_ACTIVE_LOW>;     
		powerdown-gpios = <&gpio1 6 GPIO_ACTIVE_LOW>;         
		vaa-supply = <&reg_2p7v>;
		vdd-supply = <&reg_1p2v>;
		vdd_io-supply = <&reg_1p8v>;
		
		status = "okay";

		port {
			ar0521_to_csi: endpoint {
				remote-endpoint = <&csi1_from_mipi>;
            	data-lanes = <1 2 3 4>;  
            	bus-type = <4>;          // MIPI CSI-2
			};
		};
	};

};

&i2c3 {
	#address-cells = <1>;
	#size-cells = <0>;
	status = "okay";

	exc80w46: touchscreen@2a {
		compatible = "eeti,exc80h60";
		pinctrl-names = "default";
		pinctrl-0 = <&pinctrl_touch_irq>, <&pinctrl_touch_reset>;
		reg = <0x2a>;
		interrupt-parent = <&gpio1>;
		interrupts = <13 IRQ_TYPE_LEVEL_LOW>;
		status = "disabled";
	};

	acdc@3c {
		compatible = "acdc,acdc_touch";
		reg = <0x3c>;
		interrupt-parent = <&gpio1>;
		interrupts = <13 IRQ_TYPE_LEVEL_LOW>;
		acdc_irq_gpio = <&gpio1 13 IRQ_TYPE_EDGE_FALLING>;
		acdc_reset_gpio = <&gpio3 26 GPIO_ACTIVE_HIGH>;
		acdc_x_resolution = <1024>;
		acdc_y_resolution = <768>;
		status = "okay";
	};

};

&i2c4 {
	status = "okay";
};

&mipi_csi_1 {
	#address-cells = <1>;
	#size-cells = <0>;
	status = "okay";
/*
	port {
		csi1_mipi_ep: endpoint@2 {
			remote-endpoint = <&csi1_ep>;
		};
	};
*/
    port@0 {
        reg = <0>;
        csi1_from_mipi: endpoint{
            remote-endpoint = <&ar0521_to_csi>;
            data-lanes = <1 2 3 4>;  
            bus-type = <4>;          // MIPI CSI-2
        };
    };
};

&csi1_bridge {
	fsl,mipi-mode;
	status = "okay";
/*
	port {
		csi1_ep: endpoint {
			remote-endpoint = <&csi1_mipi_ep>;
		};
	};	
*/	
};

&usbotg1 {
	dr_mode = "otg";
	disable-over-current;
	pinctrl-names = "default";
	power-active-high;
	vbus-supply = <&reg_usb_otg_vbus>;
	status = "okay";

	ports {
		#address-cells = <1>;
		#size-cells = <0>;

		port@0 {
			reg = <0>;
			otg1_out_ep: endpoint {
				remote-endpoint = <&hd3ss3220_in_ep>;
			};
		};

		port@1 {
			reg = <1>;
			otg1_in_ep: endpoint {
				remote-endpoint = <&hd3ss3220_out_ep>;
			};
		};
	};
};
